## config/boards/shields/zaphod_lite/Kconfig.config
```kconfig
# Copyright (c) 2020 The ZMK Contributors
# SPDX-License-Identifier: MIT

if SHIELD_ZAPHOD_LITE

config ZMK_KEYBOARD_NAME
    default "Zaphod Lite"

config SPI
	default y

CONFIG_ZMK_DISPLAY = n


endif # SHIELD_ZAPHOD_LITE
```

## config/boards/shields/zaphod_lite/boards/seeeduino_xiao_ble.conf
```kconfig
CONFIG_SPI=y
CONFIG_ZMK_HID_REPORT_TYPE_NKRO=n
CONFIG_ZMK_COMBO_MAX_COMBOS_PER_KEY=20
CONFIG_ZMK_BLE_THREAD_STACK_SIZE=768
CONFIG_ZMK_BATTERY_REPORTING=n
```

## config/west.yml
```yaml
manifest:
  remotes:
    - name: zmkfirmware
      url-base: https://github.com/zmkfirmware
    - name: urob
      url-base: https://github.com/urob
projects:
    - name: zmk
      remote: zmkfirmware
      revision: v0.3
      import: app/west.yml
    - name: zmk-adaptive-key
      remote: urob
      revision: v0.3
self:
  path: config
```
